## buildroot/impl/package/Config.in
```kconfig
source "$BR2_EXTERNAL_IMPL_PATH/package/dma_driver/Config.in"
source "$BR2_EXTERNAL_IMPL_PATH/package/user_app/Config.in"
```

## os/impl/Config.in
```kconfig
source "$BR2_EXTERNAL_IMPL_PATH/package/Config.in"
source "$BR2_EXTERNAL_IMPL_PATH/package/Config.in.host"
```

## os/impl/package/user_app/Config.in
```kconfig
config BR2_PACKAGE_USER_APP
        bool "user_app"
        help
          my user application
```
